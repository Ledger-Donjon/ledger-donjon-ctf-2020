PROVIDE(shell_addr = 0x20001cd0);
PROVIDE(reset = 0x08001069);
PROVIDE(debug_print = 0x080009f7);
PROVIDE(debug_println = 0x08000a0d);
PROVIDE(debug_print_u32 = 0x08000a35);
PROVIDE(debug_print_i32 = 0x08000a21);
PROVIDE(socket_connect = 0x08000db5);
PROVIDE(socket_print = 0x08001039);
PROVIDE(socket_write = 0x08000ea5);
PROVIDE(verify_pin = 0x080001fd);
PROVIDE(sec_reset = 0x08000181);
PROVIDE(delay = 0x08001055);
PROVIDE(usart_rx = 0x08000937);
PROVIDE(usart_tx = 0x080008fb);
PROVIDE(usart_tx_buf = 0x0800091d);
PROVIDE(usart_flush = 0x080008ed);
PROVIDE(usart_avail = 0x080009d9);
PROVIDE(usart_rx_buf = 0x08000965);
PROVIDE(xmemset = 0x080010c3);
PROVIDE(w5500 = 0x20000010);
PROVIDE(usart_sec = 0x20000000);
PROVIDE(debug_key = 0x2000000c);
PROVIDE(debug_enabled = 0x20000008);
